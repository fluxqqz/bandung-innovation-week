#include <Arduino.h>
#include <SPI.h>
#include <GxEPD2_BW.h>
#include <string.h>

// Same display and wiring as your original sketch.
#define EPD_BUSY  7
#define EPD_RST   8
#define EPD_DC    9
#define EPD_CS   10
#define EPD_SCK  12
#define EPD_MOSI 11

GxEPD2_BW<GxEPD2_154_D67, GxEPD2_154_D67::HEIGHT> display(
    GxEPD2_154_D67(EPD_CS, EPD_DC, EPD_RST, EPD_BUSY));

// photo(1).txt contains 40,000 RGB565 pixels, in row-major order.
constexpr uint16_t IMG_W = 200;
constexpr uint16_t IMG_H = 200;
constexpr uint32_t PIXEL_COUNT = uint32_t(IMG_W) * IMG_H;
constexpr uint16_t ROW_BYTES = (IMG_W + 7) / 8;
constexpr uint32_t SERIAL_BAUD = 500000;
constexpr uint32_t RX_TIMEOUT_MS = 5000; // Maximum silence mid-transfer.
constexpr uint32_t PHOTO_DURATION_MS = 180000; // Show each photo for three minutes.

// ===== LOGO IDLE (menggantikan tulisan MONOSNAP) =====
constexpr uint16_t LOGO_W = 180;
constexpr uint16_t LOGO_H = 111;

// 'Logo Artha 2025 Black V (2) 1 (3)', 180x111px (bit 1 = putih/background, bit 0 = hitam/logo)
const unsigned char epd_bitmap_Logo_Artha_2025_Black_V__2__1__3_ [] PROGMEM = {
  0xff, 0xff, 0xff, 0xff, 0xff, 0xff, 0xff, 0xff, 0xff, 0xff, 0xf0, 0x00, 0xff, 0xff, 0xff, 0xff,
  0xff, 0xff, 0xff, 0xff, 0xff, 0xff, 0xf0, 0xff, 0xff, 0xff, 0xff, 0xff, 0xff, 0xff, 0xff, 0xff,
  0xfe, 0x00, 0x00, 0x0f, 0xff, 0xff, 0xff, 0xff, 0xff, 0xff, 0xff, 0xff, 0xff, 0xf0, 0xff, 0xff,
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  0xfe, 0x1f, 0xff, 0xff, 0xff, 0xff, 0xff, 0x8f, 0xf0
};
// =====================================================

uint32_t photoShownAt = 0;
bool photoShowing = false;

// 1 = black; 0 = white. No full RGB565 image or large String is stored.
uint8_t imgBuf[ROW_BYTES * IMG_H];
float currentErrors[IMG_W + 2];
float nextErrors[IMG_W + 2];

uint32_t pixelCount = 0;
uint32_t lastRxAt = 0;
uint16_t tokenValue = 0;
uint8_t tokenState = 0; // 0: waiting, 1: saw '0', 2..5: hex digits.
bool frameReady = false;
bool receiveError = false;

void printReady() {
  Serial.println("READY 200 200 RGB565_HEX 40000");
}
void resetReceiver() {
  memset(imgBuf, 0, sizeof(imgBuf));
  memset(currentErrors, 0, sizeof(currentErrors));
  memset(nextErrors, 0, sizeof(nextErrors));
  pixelCount = 0;
  tokenState = 0;
  tokenValue = 0;
  frameReady = false;
  receiveError = false;
}

void failReceive(const char* message) {
  Serial.print("ERROR ");
  Serial.println(message);
  Serial.println("Stop sending; wait for READY, then resend the whole image.");

  // Discard the remainder of this transfer until the input becomes quiet.
  receiveError = true;
}

int hexDigit(char c) {
  if (c >= '0' && c <= '9') return c - '0';
  if (c >= 'a' && c <= 'f') return c - 'a' + 10;
  if (c >= 'A' && c <= 'F') return c - 'A' + 10;
  return -1;
}

void acceptPixel(uint16_t rgb565) {
  const uint16_t x = pixelCount % IMG_W;
  const uint16_t y = pixelCount / IMG_W;

  // Expand RGB565 channels to 8-bit brightness values.
  const uint8_t r = (((rgb565 >> 11) & 31) * 255 + 15) / 31;
  const uint8_t g = (((rgb565 >> 5) & 63) * 255 + 31) / 63;
  const uint8_t b = ((rgb565 & 31) * 255 + 15) / 31;
  const float gray = 0.299f * r + 0.587f * g + 0.114f * b;

  // Streaming Floyd-Steinberg dithering, using only two error rows.
  const float oldValue = gray + currentErrors[x + 1];
  const bool black = oldValue < 128.0f;
  const float error = oldValue - (black ? 0.0f : 255.0f);

  if (black) imgBuf[y * ROW_BYTES + x / 8] |= uint8_t(0x80 >> (x & 7));
  if (x + 1 < IMG_W) currentErrors[x + 2] += error * (7.0f / 16.0f);
  if (y + 1 < IMG_H) {
    if (x > 0) nextErrors[x] += error * (3.0f / 16.0f);
    nextErrors[x + 1] += error * (5.0f / 16.0f);
    if (x + 1 < IMG_W) nextErrors[x + 2] += error * (1.0f / 16.0f);
  }

  if (x + 1 == IMG_W) {
    memcpy(currentErrors, nextErrors, sizeof(currentErrors));
    memset(nextErrors, 0, sizeof(nextErrors));
  }

  ++pixelCount;
  if (pixelCount == PIXEL_COUNT) frameReady = true;
}

void receiveChar(char c) {
  if (receiveError || frameReady) return;
  if (tokenState == 0) {
    // Separators can appear between values or between rows.
    if (c == ',' || c == ' ' || c == '\r' || c == '\n' || c == '\t') return;
    // An idle sender may query readiness with '?' (not part of the file).
    if (c == '?' && pixelCount == 0) {
      printReady();
      return;
    }
    if (c != '0') {
      failReceive("Expected a pixel beginning with 0x.");
      return;
    }
    tokenState = 1;
    return;
  }

  if (tokenState == 1) {
    if (c != 'x' && c != 'X') {
      failReceive("Expected x after 0.");
      return;
    }
    tokenValue = 0;
    tokenState = 2;
    return;
  }

  const int digit = hexDigit(c);
  if (digit < 0) {
    failReceive("Each pixel must contain exactly four hex digits: 0xNNNN.");
    return;
  }
  tokenValue = uint16_t((tokenValue << 4) | digit);
  ++tokenState;
  if (tokenState == 6) {
    tokenState = 0;
    acceptPixel(tokenValue);
  }
}

// ===== showIdle() versi logo =====
void showIdle() {
  const int16_t OFFSET_ATAS  = -5;  // naikkan logo (pixel)
  const int16_t OFFSET_KANAN = -1;   // geser kanan (+) / kiri (-)
  const int16_t ox = (int16_t(IMG_W) - int16_t(LOGO_W)) / 2 + OFFSET_KANAN;
  const int16_t oy = (int16_t(IMG_H) - int16_t(LOGO_H)) / 2 - OFFSET_ATAS;
  display.firstPage();
  do {
    display.fillScreen(GxEPD_WHITE);
    display.fillRect(ox, oy, LOGO_W, LOGO_H, GxEPD_BLACK);
    display.drawBitmap(ox, oy, epd_bitmap_Logo_Artha_2025_Black_V__2__1__3_, LOGO_W, LOGO_H, GxEPD_WHITE);
  } while (display.nextPage());
}

void showPhoto() {
  display.firstPage();
  do {
    display.fillScreen(GxEPD_WHITE);
    display.drawBitmap(0, 0, imgBuf, IMG_W, IMG_H, GxEPD_BLACK);
  } while (display.nextPage());
}

void setup() {
  Serial.begin(SERIAL_BAUD);
  SPI.begin(EPD_SCK, -1, EPD_MOSI, EPD_CS);
  display.epd2.selectSPI(SPI, SPISettings(4000000, MSBFIRST, SPI_MODE0));
  // Disable GxEPD2 diagnostic output to keep the serial protocol clear.
  display.init(0, true, 2, false);
  display.setRotation(0);
  display.setFullWindow();
  display.setTextColor(GxEPD_BLACK);
  display.setTextSize(2);
  display.setTextWrap(false);
  resetReceiver();
  showIdle();
  printReady();
}
void loop() {
  while (Serial.available() > 0 && !frameReady) {
    const char c = char(Serial.read());
    lastRxAt = millis();
    receiveChar(c);
  }
  if (frameReady) {
    Serial.println("RECEIVED 40000");
    // Stop transmitting while this synchronous refresh is in progress.
    showPhoto();
    // Begin the three-minute interval after the panel refresh completes.
    photoShownAt = millis();
    photoShowing = true;
    resetReceiver();
    Serial.println("DISPLAYED");
    printReady();
  } else if ((receiveError || pixelCount > 0 || tokenState > 0) &&
             uint32_t(millis() - lastRxAt) >= RX_TIMEOUT_MS) {
    if (!receiveError) Serial.println("ERROR Incomplete image: serial timeout.");
    resetReceiver();
    printReady();
  }
  // Wait for an active transfer to finish or time out before refreshing idle,
  // so the synchronous panel refresh does not interrupt incoming pixel data.
  if (photoShowing && uint32_t(millis() - photoShownAt) >= PHOTO_DURATION_MS &&
      pixelCount == 0 && tokenState == 0 && !receiveError &&
      Serial.available() == 0) {
    photoShowing = false;
    Serial.println("BUSY Returning to idle.");
    showIdle();
    Serial.println("IDLE MONOSNAP");
    printReady();
  }
}